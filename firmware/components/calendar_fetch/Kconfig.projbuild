## firmware/components/calendar_fetch/Kconfig.projbuild
```kconfig
menu "Glance Calendar"

    config GLANCE_ICS_URL_1
        string "ICS URL 1"
        default ""
        help
            Private iCal URL of a calendar to show. Treat it as a secret --
            anyone with it can read the calendar. Local to sdkconfig
            (gitignored) until provisioning (M7) replaces this. Leave unused
            slots empty.

    config GLANCE_ICS_URL_2
        string "ICS URL 2"
        default ""
        help
            See ICS URL 1.

    config GLANCE_ICS_URL_3
        string "ICS URL 3"
        default ""
        help
            See ICS URL 1.

    config GLANCE_ICS_URL_4
        string "ICS URL 4"
        default ""
        help
            See ICS URL 1.

    config GLANCE_ICS_URL_5
        string "ICS URL 5"
        default ""
        help
            See ICS URL 1.

endmenu
```

## firmware/components/ota_update/Kconfig.projbuild
```kconfig
menu "Glance Updates"

    config GLANCE_OTA_RELEASE_URL
        string "Where releases are published"
        default "https://github.com/bolintw/Glance/releases/latest/download"
        help
            The latest release's download directory (published by
            .github/workflows/release.yml). Each board reads its own update
            manifest there (board::kOtaManifest), so a device never installs
            a build for another board. Only release builds -- version
            vX.Y.Z, from firmware/version.txt -- ever update themselves; a
            development build never does.

endmenu
```

## firmware/components/settings/Kconfig.projbuild
```kconfig
# Development fallbacks. The device's own settings (entered on its setup
# page, stored in NVS) win; these only fill in what was never set there.
# Values live in sdkconfig, which is gitignored -- never in
# sdkconfig.defaults.

menu "Glance WiFi"

    config GLANCE_WIFI_SSID
        string "WiFi SSID"
        default ""

    config GLANCE_WIFI_PASSWORD
        string "WiFi password"
        default ""

endmenu

menu "Glance Calendar"

    config GLANCE_ICS_URL_1
        string "ICS URL 1"
        default ""
        help
            Private iCal URL of a calendar to show. Treat it as a secret --
            anyone with it can read the calendar. Leave unused slots empty.

    config GLANCE_ICS_URL_2
        string "ICS URL 2"
        default ""
        help
            See ICS URL 1.

    config GLANCE_ICS_URL_3
        string "ICS URL 3"
        default ""
        help
            See ICS URL 1.

    config GLANCE_ICS_URL_4
        string "ICS URL 4"
        default ""
        help
            See ICS URL 1.

    config GLANCE_ICS_URL_5
        string "ICS URL 5"
        default ""
        help
            See ICS URL 1.

endmenu

menu "Glance Weather"

    config GLANCE_CWA_API_KEY
        string "CWA open data API key"
        default ""
        help
            Authorization key from opendata.cwa.gov.tw (member page). Treat
            it as a secret. Leave empty to show no weather.

    config GLANCE_WEATHER_LOCATION
        string "County or city"
        default ""
        help
            Exactly as CWA writes it, e.g. 臺北市 or 新竹縣 (臺, not 台).

endmenu
```

## firmware/components/weather_fetch/Kconfig.projbuild
```kconfig
menu "Glance Weather"

    config GLANCE_CWA_API_KEY
        string "CWA open data API key"
        default ""
        help
            Authorization key from opendata.cwa.gov.tw (member page). Treat
            it as a secret. Leave empty to show no weather. Local to sdkconfig
            (gitignored) until provisioning (M7) replaces this.

    config GLANCE_WEATHER_LOCATION
        string "County or city"
        default ""
        help
            Exactly as CWA writes it, e.g. 臺北市 or 新竹縣 (臺, not 台).

endmenu
```

## firmware/components/wifi_manager/Kconfig.projbuild
```kconfig
menu "Glance WiFi"

    config GLANCE_WIFI_SSID
        string "WiFi SSID"
        default ""
        help
            SSID for the M1 WiFi connectivity regression test. Local to
            sdkconfig (gitignored) -- not baked into sdkconfig.defaults.

    config GLANCE_WIFI_PASSWORD
        string "WiFi password"
        default ""
        help
            WPA2 password. Local to sdkconfig (gitignored).

endmenu
```

## firmware/main/Kconfig.projbuild
```kconfig
menu "Glance Board"

    choice GLANCE_BOARD
        prompt "Board"
        default GLANCE_BOARD_V3_0
        help
            Which eCalendar board this build is for: the pins (main/board.hpp)
            and the update manifest it reads. V3.0 is the only one (V2.1 was
            dropped on 2026-10-22); a new board becomes another choice here.

        config GLANCE_BOARD_V3_0
            bool "eCalendar V3.0 (USB and charge status inputs, no external flash)"
    endchoice

endmenu

menu "Glance Display Backend"

    choice GLANCE_DISPLAY_BACKEND
        prompt "Display backend"
        default GLANCE_DISPLAY_BACKEND_EPD
        help
            M2: swap between the real EPD and a PC-side simulator without
            touching any code above the Display interface (main.cpp only
            changes which concrete class it constructs).

        config GLANCE_DISPLAY_BACKEND_EPD
            bool "Real EPD (SPI)"

        config GLANCE_DISPLAY_BACKEND_SIMULATOR
            bool "Serial dump simulator (no physical screen needed, see firmware/tools/display_sim)"
    endchoice

endmenu

menu "Glance Privacy Mode"

    config GLANCE_PHOTO_4GRAY
        bool "Show photos in four gray levels"
        default y
        help
            Use the panel's 4-gray mode for privacy mode's photo instead of
            black-and-white dithering. Only Waveshare 7.5" V2 panels sold
            after 2023-10 carry the 4-gray waveform (see Waveshare's
            EPD_7IN5_V2_Init_4Gray); turn this off for an older panel,
            which shows it wrong. Confirmed on a current panel: the levels
            come out in order, with no ghosting after the white clear.

endmenu

menu "Glance Refresh"

    config GLANCE_REFRESH_HOUR
        int "Daily refresh hour (local time)"
        range 0 23
        default 7
        help
            The panel is redrawn once a day at this hour (minute 0), until
            the setup page sets other times (one or two a day). Press RST to
            redraw it right away.

    config GLANCE_RETRY_MINUTES
        int "Retry after a failed refresh (minutes)"
        range 5 1440
        default 60
        help
            If WiFi, NTP, every calendar or the panel fails, the screen is
            left as is and the device tries again after this long.

    config GLANCE_DEV_SETUP_ON_LAN
        bool "Development: serve the setup pages on the home network"
        depends on !GLANCE_DEEP_SLEEP
        default n
        help
            While waiting awake for the next refresh, serve the setup and
            photo pages on the network the device is connected to, so a
            computer there can drive them (end-to-end tests without joining
            the setup access point). No password protects them -- never
            enable this on a device in use.

    config GLANCE_DEV_SERIAL_COMMANDS
        bool "Development: accept button commands on the USB serial console"
        default n
        help
            Lines like "glance press short", "glance press long",
            "glance privacy on|off" and "glance refresh" act as the button
            does, so tests can drive it without anyone pressing it.
            "glance hw" prints a check of a new board: slow clock, USB and
            charge status, fuel gauge, panel.

    config GLANCE_DEEP_SLEEP
        bool "Deep sleep until the next refresh"
        default y
        help
            Turn off during development: in deep sleep the USB serial port
            disappears, so flashing needs RST by hand. When off, the device
            stays awake until the next refresh time and then reboots, so it
            keeps refreshing on schedule (without the power savings).

endmenu
```

## firmware/tools/discharge/main/Kconfig.projbuild
```kconfig
menu "Discharge tool"

    config DISCHARGE_STEPS
        bool "Load steps instead of a discharge"
        default n
        help
            For comparing boards' current draw: forever, 10s each of
            (1) idle -- CPU idle, Wi-Fi stopped, (2) both cores spinning,
            (3) both cores spinning and Wi-Fi scanning. The peripheral rail
            stays off (no LED), and the fuel gauge isn't used.

    config DISCHARGE_TARGET_MV
        int "Stop at this resting battery voltage (mV)"
        range 3000 4100
        default 3500
        help
            Read with the load off for DISCHARGE_REST_SECONDS, so it's close
            to the cell's open-circuit voltage. 3500 is about 5% left; 3000
            is empty by a cell's rated-capacity definition -- charge it
            soon after, since sitting at that voltage wears it.

    config DISCHARGE_LOAD_MINUTES
        int "Minutes at full load between readings"
        range 1 60
        default 5

    config DISCHARGE_REST_SECONDS
        int "Seconds with the load off before each reading"
        range 10 600
        default 60

    config DISCHARGE_LED_PIN
        int "Status LED pin (active low; V2.1: 48, V3.0: 38)"
        default 48

    config DISCHARGE_RAIL_PIN
        int "Peripheral rail switch pin (V2.1: 14, V3.0: 41)"
        default 14

endmenu
```
